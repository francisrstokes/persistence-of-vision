#include <avr/io.h>
#include <stdint-gcc.h>
#include <util/delay.h>

#define FRAME_DELAY     (32) // Milliseconds
#define KERNING_DELAY   (12) // Milliseconds
#define FRAMES_PER_CHAR (5)

// The contents of this array was generated by running the "font-to-array.py" script
const uint8_t letters[][5] = {
  { 0xff, 0x90, 0x90, 0x90, 0xff }, // A [0]
  { 0xff, 0x91, 0x91, 0x91, 0x6e }, // B [1]
  { 0xff, 0x81, 0x81, 0x81, 0x81 }, // C [2]
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  { 0x00, 0x00, 0x00, 0x00, 0x00 }, // " " [26]
};

uint8_t get_char_index(char c) {
  if (c >= 'a' && c <= 'z') {
    return c - 'a';
  } else if (c >= 'A' && c <= 'Z') {
    return c - 'A';
  } else {
    return 26; // Space for everything else
  }
}

void show_message(const char* message) {
  uint8_t message_index = 0;

  while (message[message_index]) {
    uint8_t char_index = get_char_index(message[message_index]);
    for (uint8_t i = 0; i < FRAMES_PER_CHAR; i++) {
      PORTD = letters[char_index][i];
      _delay_ms(FRAME_DELAY);
    }

    message_index++;
    PORTD = 0;
    _delay_ms(KERNING_DELAY);
  }
}

int main (void) {
  // Disable the UART receiver and transmitter to avoid RX and TX being pulled high
  UCSR0B = 0;

  // This is designed to run on an arduino nano. Port D is the only port where all 8 signals are
  // broken out and usable. On the hardware I've added a jumper on PD0 so that it can still be easily
  // flashed over UART.
  DDRD |= 0xff; // The entire port is an output

  const char* message = "Low Byte Productions";

  while (1) {
    show_message(message);
    _delay_ms(2200);
  }
}
